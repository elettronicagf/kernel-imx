/dts-v1/;
#include <dt-bindings/input/input.h>
#include "imx7d-egf-0575.dtsi"
#include "imx7d-egf-0574-evb.dtsi"

/ {
	model = "Elettronica GF i.MX7D SOM WIDAA";
	compatible = "fsl,imx7d-egf", "fsl,imx7d";
	
};

&fec2 {
	status = "okay";
};

&weim {
	status = "disabled";
};