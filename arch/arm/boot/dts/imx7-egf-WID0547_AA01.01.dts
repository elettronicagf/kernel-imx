/dts-v1/;
#include <dt-bindings/input/input.h>
#include "imx7d-egf-0377-evb.dtsi"

/ {
	model = "Elettronica GF i.MX7D EVB";
	compatible = "fsl,imx7-egf", "fsl,imx7d";
	
	memory {
		reg = <0x80000000 0x80000000>;
	};

};
