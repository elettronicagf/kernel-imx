/*
 * Copyright 2013 Freescale Semiconductor, Inc.
 *
 * Author: Fabio Estevam <fabio.estevam@freescale.com>
 *
 * This program is free software; you can redistribute it and/or modify
 * it under the terms of the GNU General Public License version 2 as
 * published by the Free Software Foundation.
 *
 */

/dts-v1/;
#include "imx6q.dtsi"
#include "imx6-egf-evb-pop.dtsi"

/ {
	model = "Elettronica GF - i.MX6D 0541";
	compatible = "egf,imx6q-egf","fsl,imx6q"; 
};
